## meta-tibbo/conf/machine/include/tppg1-base.inc
```bitbake
XSERVER ?= "xserver-xorg \
           xf86-input-evdev \
           xf86-input-mouse \
           xf86-video-fbdev \
           xf86-video-omapfb \
           xf86-input-keyboard"

MACHINE_EXTRA_RRECOMMENDS = " kernel-modules kernel-devicetree"

EXTRA_IMAGEDEPENDS += "u-boot"
EXTRA_IMAGEDEPENDS += "dtc-native"

IMAGE_FSTYPES += "tar.bz2 ubi"
UBI_VOLNAME="rootfs"
MKUBIFS_ARGS = "-F -m 2048 -e 126976 -c 4036"
UBINIZE_ARGS = "-m 2048 -p 128KiB -s 2048"

SERIAL_CONSOLES ?= "115200;ttyO0"

KERNEL_IMAGETYPE = "uImage"
KERNEL_DEVICETREE = ""
KERNEL_DEVICETREE += "am335x-TPPs2.dtb"
KERNEL_DEVICETREE += "am335x-TPPs3.dtb"
KERNEL_DEVICETREE += "am335x-TPPs3-t-gpio.dtb"
KERNEL_DEVICETREE += "am335x-TPPs3-t-buzzer.dtb"
KERNEL_DEVICETREE += "am335x-TPPs3-t-can.dtb"
KERNEL_DEVICETREE += "am335x-TPPs3-t-uart.dtb"
KERNEL_DEVICETREE += "am335x-TPPs3-t-usb.dtb"
KERNEL_DEVICETREE += "am335x-TPPA-t-usb.dtb"
KERNEL_DEVICETREE += "am335x-TPPs3-t-usb-host.dtb"
KERNEL_DEVICETREE += "am335x-TPPs3-t-usb-peri.dtb"
KERNEL_DEVICETREE += "am335x-TPPs3-t-i2c.dtb"
KERNEL_DEVICETREE += "am335x-TPPs3-t-mmc.dtb"
KERNEL_DEVICETREE += "am335x-TPPs3-t-sound.dtb"
KERNEL_DEVICETREE += "am335x-TPPs3-RLP.dtb"
KERNEL_DEVICETREE += "am335x-TPPs3-fwuploader.dtb"
KERNEL_DEVICETREE += "am335x-KLM601.dtb"
KERNEL_DEVICETREE += "am335x-KLM601.revB.dtb"
KERNEL_DEVICETREE += "am335x-KLM601.revC.dtb"
KERNEL_EXTRA_ARGS += "LOADADDR=${UBOOT_ENTRYPOINT}"

MLO_BINARY = "MLO"
SPL_BINARY = "spl/u-boot-spl.bin"
UBOOT_SUFFIX = "img"
#UBOOT_MACHINE = "am335x_evm_config"
#UBOOT_MACHINE = "am335x_tpp_config"
#UBOOT_MACHINE = "am335x_tpp_fast_config"
UBOOT_CONFIG ??= "tppg1 klm601"
UBOOT_CONFIG[tppg1] = "am335x_tppg1_config"
UBOOT_CONFIG[klm601] = "am335x_klm601_config"
UBOOT_ENTRYPOINT = "0x80008000"
UBOOT_LOADADDRESS = "0x80008000"

IMAGE_BOOT_FILES ?= "u-boot.${UBOOT_SUFFIX} MLO"
```

## meta-tibbo/conf/machine/include/tppg1-prefs.inc
```bitbake
# ---- versions

PREFERRED_VERSION_linux-yocto ?= "4.12%"

PREFERRED_VERSION_u-boot ?= "2018.01"
PREFERRED_VERSION_u-boot-fw-utils ?= "2018.01"
```

## meta-tibbo/conf/machine/include/tppg2-all-prefs.inc
```bitbake
# SRC_URI mirrors is defined at:
# meta-sunplus/recipes-bsp/isp/isp.bb
# meta-sunplus/recipes-bsp/b-chip/bnoos.bb
# meta-sunplus/recipes-bsp/xboot/xboot-src.inc
# meta-sunplus/recipes-bsp/u-boot/u-boot-src.inc

uboot_v = "sp"
PREFERRED_VERSION_u-boot-fw-utils = "${uboot_v}"
PREFERRED_VERSION_u-boot-tools = "${uboot_v}"
PREFERRED_VERSION_u-boot-tools-native = "${uboot_v}"
PREFERRED_VERSION_u-boot = "${uboot_v}"

# possible values:
# linux-sp - public github version
# linux-yocto - traditional Yocto version
# SRC_URI for "sp" is defined at:
# meta-sunplus/recipes-kernel/linux/linux-sp_%.bbappend

linux_v = "sp"
PREFERRED_PROVIDER_virtual/kernel = "linux-${linux_v}"
```

## meta-tibbo/conf/machine/include/tppg2-base-arm5.inc
```bitbake
#EXTRA_IMAGEDEPENDS += "xboot"

SERIAL_CONSOLES ?= "115200;ttyS0"

IMAGE_BOOT_FILES ?= "xboot.sss"

# revA
#XBOOT_CONFIG ?= "q628_defconfig"
# revB
XBOOT_CONFIG ?= "q628_Rev2_EMMC_defconfig"

XBOOT_CONFIGS[q628_r1_defc] = "q628_defconfig"
XBOOT_CONFIGS[q628_r2_emmc] = "q628_Rev2_EMMC_defconfig"
XBOOT_CONFIGS[q628_r2_spin] = "q628_Rev2_SPINAND_defconfig"
```

## meta-tibbo/conf/machine/include/tppg2-base.inc
```bitbake
XSERVER ?= "xserver-xorg \
           xf86-input-evdev \
           xf86-input-mouse \
           xf86-video-fbdev \
           xf86-input-keyboard"

MACHINE_EXTRA_RRECOMMENDS = " kernel-modules kernel-devicetree"

EXTRA_IMAGEDEPENDS += "u-boot"
EXTRA_IMAGEDEPENDS += "dtc-native"
do_image_wic[depends] += "isp-native:do_deploy"

IMAGE_FSTYPES += "tar.bz2 ext4 squashfs ubi"
UBI_VOLNAME="rootfs"
# 
# -m is min io unit
# -s is sub-page-size (flash can support smaller blocks - subpages)
# -p is PEB (x*1024)
# -e is LEB size = PEB size - EC - VID
# -c is maximum ubi volume size (for auto-resize)
# calcs: http://www.linux-mtd.infradead.org/faq/ubi.html#L_ubi_mkimg
#MKUBIFS_ARGS = "-F -m 2048 -e 126976 -c 4036"
# 2030 is for 2G NAND
#MKUBIFS_ARGS = "-F -m 2048 -e 126976 -c 2030 -x zlib"
#MKUBIFS_ARGS = "-F -m 2048 -e 126976 -c 2030"
MKUBIFS_ARGS = "-F -m 2048 -e 126976 -c 4060"
#UBINIZE_ARGS = "-m 2048 -p 128KiB -s 2048"
UBINIZE_ARGS = "-m 2048 -p 124KiB -s 2048"

# SDcard image
IMAGE_FSTYPES += "wic wic.bz2"
WKS_FILE = "sdimage.tppg2.wks"

SERIAL_CONSOLES ?= "115200;ttyS0"

KERNEL_IMAGETYPE = "uImage"
KERNEL_DEVICETREE = ""
KERNEL_DEVICETREE += "sp7021-ltpp3g2revD.dtb"
KERNEL_DEVICETREE += "sp7021-dsx.dtb"
KERNEL_DEVICETREE += "sp7021-ev.dtb"
KERNEL_DEVICETREE += "sp7021-bpi-f2p.dtb"
KERNEL_DEVICETREE += "sp7021-bpi-f2s.dtb"
KERNEL_DEVICETREE += "sp7021-demov2.dtb"
KERNEL_DEVICETREE += "sp7021-demov3.dtb"
KERNEL_DEVICETREE += "sp7021-icognize.dtb"
KERNEL_EXTRA_ARGS += "LOADADDR=${UBOOT_ENTRYPOINT}"

UBOOT_CONFIG ??= "a7021_emmc a7021_nand a7021_romt a7021_ppg2 a7021_dsxe"
#UBOOT_CONFIG ??= "a7021_emmc a7021_ppg2 a7021_dsxe"
#UBOOT_CONFIG ??= "tppg2"
#UBOOT_CONFIG[tppg2] = "pentagram_sp7021_emmc_defconfig"
UBOOT_CONFIG[a7021_emmc] = "sp7021_emmc_c_defconfig"
UBOOT_CONFIG[a7021_nand] = "sp7021_nand_c_defconfig"
UBOOT_CONFIG[a7021_romt] = "sp7021_romter_c_defconfig"
UBOOT_CONFIG[a7021_ppg2] = "sp7021_tppg2_defconfig"
UBOOT_CONFIG[a7021_dsxe] = "sp7021_dsxe_defconfig"
UBOOT_ENTRYPOINT = "0x00308000"
UBOOT_LOADADDRESS = "0x00308000"

IMAGE_BOOT_FILES  = "u-boot.bin-a7021_emmc.img;u-boot.img"
IMAGE_BOOT_FILES += "sdcard_uEnv.txt;uEnv.txt"
#IMAGE_BOOT_FILES += "a926.img"
IMAGE_BOOT_FILES += "${KERNEL_IMAGETYPE}-initramfs-tppg2.img;${KERNEL_IMAGETYPE}"
#IMAGE_BOOT_FILES += "ISPBOOOT.BIN"
# move this
IMAGE_BOOT_FILES += "sp7021-ltpp3g2-empty.dtb;dtb"

PACKAGE_FEED_ARCHS = "cortexa9hf_neon noarch ${MACHINE}"
```

## meta-tibbo/conf/machine/tpp-tppg1.conf
```bitbake
#@TYPE: Machine
#@NAME: based on Beaglebone Black - AM335x TPP machine
#@DESCRIPTION: Machine configuration for the LTPS http://tibbo.com/store/tps/ltpp3.html

MACHINEOVERRIDES = "tppg1:${MACHINE}"
require conf/machine/tppg1.conf
```

## meta-tibbo/conf/machine/tpp-tppg2-arm5.conf
```bitbake
#@TYPE: Machine
#@NAME: based on SunPlus - SunPlus TPP machine
#@DESCRIPTION: Machine configuration for the LTPS http://tibbo.com/store/tps/ltpp3.html

MACHINEOVERRIDES = "tppg2-arm5:${MACHINE}"
require conf/machine/tppg2-arm5.conf
```

## meta-tibbo/conf/machine/tpp-tppg2.conf
```bitbake
#@TYPE: Machine
#@NAME: based on SP7021 - TPP machine
#@DESCRIPTION: Machine configuration for the LTPS http://tibbo.com/store/tps/ltpp3.html

MACHINEOVERRIDES = "tppg2:${MACHINE}"
require conf/machine/tppg2.conf
```

## meta-tibbo/conf/machine/tppg1.conf
```bitbake
#@TYPE: Machine
#@NAME: based on Beaglebone Black - AM335x TPP machine
#@DESCRIPTION: Machine configuration for the LTPS http://tibbo.com/store/tps/ltpp3.html

DEFAULTTUNE ?= "cortexa8hf-neon"
require conf/machine/include/tune-cortexa8.inc

require conf/machine/include/tpp-prefs.inc
require conf/machine/include/tppg1-prefs.inc
require conf/machine/include/tppg1-base.inc

MACHINE_FEATURES  = "usbgadget usbhost ext2 vfat serial alsa"
MACHINE_FEATURES += "tpsleds"
MACHINE_FEATURES += "media-usb-webcams"
MACHINE_FEATURES += "media"
# for usb modems ?
# MACHINE_FEATURES += "serial-all usb-net"
```

## meta-tibbo/conf/machine/tppg2-arm5.conf
```bitbake
#@TYPE: Machine
#@NAME: based on SP7021 CPU - TPP machine
#@DESCRIPTION: Machine configuration for the LTPS http://tibbo.com/store/tps/ltpp3.html

# CPU features and optimizations for Pentagram-based boards

DEFAULTTUNE ?= "arm926ejs"
require conf/machine/include/tune-arm926ejs.inc
#require conf/machine/include/arm/armv5/tune-arm926ejs.inc

require conf/machine/include/tppg2-all-prefs.inc
require conf/machine/include/tppg2-arm5-prefs.inc
require conf/machine/include/tppg2-base-arm5.inc
```
