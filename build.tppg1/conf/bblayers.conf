## build.tppg1/conf/bblayers.conf
```bitbake
# POKY_BBLAYERS_CONF_VERSION is increased each time build/conf/bblayers.conf
# changes incompatibly
POKY_BBLAYERS_CONF_VERSION = "2"

BBPATH = "${TOPDIR}"
BBFILES ?= ""

BBLAYERS ?= " \
  ${TOPDIR}/../meta-tibbo \
  ${TOPDIR}/../meta \
  ${TOPDIR}/../meta-poky \
  ${TOPDIR}/../meta-yocto-bsp \
  ${TOPDIR}/../meta-qt5 \
  ${TOPDIR}/../meta-tibbopriv \
  "

BBLAYERS += " \
  ${TOPDIR}/../meta-openembedded/meta-multimedia \
  ${TOPDIR}/../meta-openembedded/meta-networking \
  ${TOPDIR}/../meta-openembedded/meta-oe \
  ${TOPDIR}/../meta-openembedded/meta-perl \
  ${TOPDIR}/../meta-openembedded/meta-python \
  ${TOPDIR}/../meta-openembedded/meta-webserver \
  "
```

## build.tppg1/conf/local.conf
```bitbake
MACHINE ?= "tppg1"
KMACHINE = "beaglebone"

DISTRO ?= "tps"

# PACKAGE_CLASSES ?= "package_rpm package_deb package_ipk"
# first is default (RPM)
PACKAGE_CLASSES ?= "package_rpm"

#EXTRA_IMAGE_FEATURES ?= "debug-tweaks"

USER_CLASSES ?= "buildstats"

PATCHRESOLVE = "noop"

BB_DISKMON_DIRS ??= "\
    STOPTASKS,${TMPDIR},1G,100K \
    STOPTASKS,${DL_DIR},1G,100K \
    STOPTASKS,${SSTATE_DIR},1G,100K \
    STOPTASKS,/tmp,100M,100K \
    ABORT,${TMPDIR},100M,1K \
    ABORT,${DL_DIR},100M,1K \
    ABORT,${SSTATE_DIR},100M,1K \
    ABORT,/tmp,10M,1K"


CONF_VERSION = "2"

# for toaster
#INHERIT+="toaster buildhistory"
```

## build.tppg2/conf/bblayers.conf
```bitbake
# POKY_BBLAYERS_CONF_VERSION is increased each time build/conf/bblayers.conf
# changes incompatibly
POKY_BBLAYERS_CONF_VERSION = "2"

BBPATH = "${TOPDIR}"
BBFILES ?= ""

BBLAYERS ?= " \
  ${TOPDIR}/../meta \
  ${TOPDIR}/../meta-poky \
  ${TOPDIR}/../meta-yocto-bsp \
  "
BBLAYERS += " \
  ${TOPDIR}/../meta-openembedded/meta-multimedia \
  ${TOPDIR}/../meta-openembedded/meta-networking \
  ${TOPDIR}/../meta-openembedded/meta-oe \
  ${TOPDIR}/../meta-openembedded/meta-perl \
  ${TOPDIR}/../meta-openembedded/meta-python \
  ${TOPDIR}/../meta-openembedded/meta-webserver \
  ${TOPDIR}/../meta-openembedded/meta-filesystems \
  "

BBLAYERS += "${TOPDIR}/../meta-tibbo"
BBLAYERS += "${TOPDIR}/../meta-sunplus"
BBLAYERS += "${TOPDIR}/../meta-priv-tibbo"
BBLAYERS += "${TOPDIR}/../meta-priv-ublox"

BBLAYERS += "${TOPDIR}/../meta-qt5"
BBLAYERS += "${TOPDIR}/../meta-openamp"

# tensorflow (face recognition)
# BBLAYERS += "${TOPDIR}/../meta-scipy"
# BBLAYERS += "${TOPDIR}/../meta-tensorflow"
# browser test
# BBLAYERS += "${TOPDIR}/../meta-clang"
# BBLAYERS += "${TOPDIR}/../meta-rust"
# BBLAYERS += "${TOPDIR}/../meta-browser"
```

## build.tppg2/conf/local.conf
```bitbake
# based on poky/meta-poky/conf/local.conf.sample

MACHINE ?= "tppg2"
DISTRO ?= "tps"

BBMULTICONFIG ?= "tpp-tppg2 tpp-tppg2-arm5 qemux86-64"

# PACKAGE_CLASSES ?= "package_rpm package_deb package_ipk"
# first is default (RPM)
PACKAGE_CLASSES ?= "package_rpm package_deb"

#EXTRA_IMAGE_FEATURES ?= "debug-tweaks"

USER_CLASSES ?= "buildstats"

PATCHRESOLVE = "noop"

BB_DISKMON_DIRS ??= "\
    STOPTASKS,${TMPDIR},1G,100K \
    STOPTASKS,${DL_DIR},1G,100K \
    STOPTASKS,${SSTATE_DIR},1G,100K \
    STOPTASKS,/tmp,100M,100K \
    ABORT,${TMPDIR},100M,1K \
    ABORT,${DL_DIR},100M,1K \
    ABORT,${SSTATE_DIR},100M,1K \
    ABORT,/tmp,10M,1K"


CONF_VERSION = "2"

# for toaster
#INHERIT+="toaster buildhistory"

# test by Dv for 3d face recognition python-scipy
FORTRAN_forcevariable = ",fortran"
# for initramfs
INITRAMFS_IMAGE_BUNDLE = "1"
INITRAMFS_IMAGE = "img-gen-rmfs"

# take 75% of total CPUs
BB_NUMBER_THREADS ?= "${@oe.utils.cpu_count()-2}"
PARALLEL_MAKE ?= "-j ${@oe.utils.cpu_count()-2}"
```

## c.tppg1/conf/bblayers.conf
```bitbake
# POKY_BBLAYERS_CONF_VERSION is increased each time build/conf/bblayers.conf
# changes incompatibly
POKY_BBLAYERS_CONF_VERSION = "2"

BBPATH = "${TOPDIR}"
BBFILES ?= ""

BBLAYERS ?= " \
  ${TOPDIR}/../meta-tibbo \
  ${TOPDIR}/../meta-tibbopriv \
  ${TOPDIR}/../meta \
  ${TOPDIR}/../meta-poky \
  ${TOPDIR}/../meta-yocto-bsp \
  ${TOPDIR}/../meta-nodejs \
  ${TOPDIR}/../meta-qt5 \
  "

BBLAYERS += " \
  ${TOPDIR}/../meta-openembedded/meta-multimedia \
  ${TOPDIR}/../meta-openembedded/meta-networking \
  ${TOPDIR}/../meta-openembedded/meta-oe \
  ${TOPDIR}/../meta-openembedded/meta-perl \
  ${TOPDIR}/../meta-openembedded/meta-python \
  ${TOPDIR}/../meta-openembedded/meta-webserver \
  "
```

## meta-priv-tibbo/conf/layer.conf
```bitbake
# We have a conf and classes directory, append to BBPATH
BBPATH .= ":${LAYERDIR}"

# We have recipes-* directories, add to BBFILES
BBFILES += "${LAYERDIR}/recipes-*/*/*.bb \
            ${LAYERDIR}/recipes-*/*/*.bbappend"

BBFILE_COLLECTIONS += "priv-tibbo"
BBFILE_PATTERN_priv-tibbo = "^${LAYERDIR}/"
BBFILE_PRIORITY_priv-tibbo = "9"
LAYERVERSION_priv-tibbo = "1"
LAYERSERIES_COMPAT_priv-tibbo = "dunfell honister"
LAYERDEPENDS_priv-tibbo  = "core"
LAYERDEPENDS_priv-tibbo += "networking-layer"
LAYERDEPENDS_priv-tibbo += "perl-layer meta-python"
LAYERDEPENDS_priv-tibbo += "tibbo"
LAYERRECOMMENDS_priv-tibbo = "qt5-layer"

# Additional license directories.
LICENSE_PATH += "${LAYERDIR}/files/custom-licenses"
LICENSE_PATH += "${LAYERDIR}/files/common-licenses"

FILESDIR_priv-tibbo := "${LAYERDIR}/files"

# The dynamic-layers directory hosts the extensions and layer specific
# modifications.
#
# The .bbappend and .bb files are included if the respective layer
# collection is available.
BBFILES += "${@' '.join('${LAYERDIR}/dynamic-layers/%s/recipes*/*/*.bbappend' % layer \
               for layer in BBFILE_COLLECTIONS.split())}"
BBFILES += "${@' '.join('${LAYERDIR}/dynamic-layers/%s/recipes*/*/*.bb' % layer \
               for layer in BBFILE_COLLECTIONS.split())}"
# or use strictly specified layer name:
#BBFILES_DYNAMIC += " \
#    otherlayer1:${LAYERDIR}/dynamic-layers/otherlayer1/recipes-*/*/*.bb \
#    otherlayer1:${LAYERDIR}/dynamic-layers/otherlayer1/recipes-*/*/*.bbappend \
#"
```

## meta-priv-ublox/conf/layer.conf
```bitbake
# We have a conf and classes directory, append to BBPATH
BBPATH .= ":${LAYERDIR}"

# We have recipes-* directories, add to BBFILES
BBFILES += "${LAYERDIR}/recipes-*/*/*.bb \
            ${LAYERDIR}/recipes-*/*/*.bbappend"

BBFILE_COLLECTIONS += "priv-ublox"
BBFILE_PATTERN_priv-ublox = "^${LAYERDIR}/"
BBFILE_PRIORITY_priv-ublox = "8"
LAYERVERSION_priv-ublox = "1"
LAYERSERIES_COMPAT_priv-ublox = "dunfell honister"
LAYERDEPENDS_priv-ublox  = "tibbo"

# Additional license directories.
LICENSE_PATH += "${LAYERDIR}/files/custom-licenses"
LICENSE_PATH += "${LAYERDIR}/files/common-licenses"

FILESDIR_priv-ublox := "${LAYERDIR}/files"

# The dynamic-layers directory hosts the extensions and layer specific
# modifications.
#
# The .bbappend and .bb files are included if the respective layer
# collection is available.
BBFILES += "${@' '.join('${LAYERDIR}/dynamic-layers/%s/recipes*/*/*.bbappend' % layer \
               for layer in BBFILE_COLLECTIONS.split())}"
BBFILES += "${@' '.join('${LAYERDIR}/dynamic-layers/%s/recipes*/*/*.bb' % layer \
               for layer in BBFILE_COLLECTIONS.split())}"
# or use strictly specified layer name:
#BBFILES_DYNAMIC += " \
#    otherlayer1:${LAYERDIR}/dynamic-layers/otherlayer1/recipes-*/*/*.bb \
#    otherlayer1:${LAYERDIR}/dynamic-layers/otherlayer1/recipes-*/*/*.bbappend \
#"
```

## meta-sunplus/conf/layer.conf
```bitbake
# We have a conf and classes directory, append to BBPATH
BBPATH .= ":${LAYERDIR}"

# We have recipes-* directories, add to BBFILES
BBFILES += "${LAYERDIR}/recipes-*/*/*.bb \
            ${LAYERDIR}/recipes-*/*/*.bbappend"

BBFILE_COLLECTIONS += "sunplus"
BBFILE_PATTERN_sunplus = "^${LAYERDIR}/"
BBFILE_PRIORITY_sunplus = "9"
LAYERVERSION_sunplus = "1"
LAYERSERIES_COMPAT_sunplus = "dunfell honister"
LAYERDEPENDS_sunplus  = "tibbo core openembedded-layer"

# Additional license directories.
LICENSE_PATH += "${LAYERDIR}/files/custom-licenses"
LICENSE_PATH += "${LAYERDIR}/files/common-licenses"

FILESDIR_sunplus := "${LAYERDIR}/files"

# The dynamic-layers directory hosts the extensions and layer specific
# modifications.
#
# The .bbappend and .bb files are included if the respective layer
# collection is available.
BBFILES += "${@' '.join('${LAYERDIR}/dynamic-layers/%s/recipes*/*/*.bbappend' % layer \
               for layer in BBFILE_COLLECTIONS.split())}"
BBFILES += "${@' '.join('${LAYERDIR}/dynamic-layers/%s/recipes*/*/*.bb' % layer \
               for layer in BBFILE_COLLECTIONS.split())}"
# or use strictly specified layer name:
#BBFILES_DYNAMIC += " \
#    otherlayer1:${LAYERDIR}/dynamic-layers/otherlayer1/recipes-*/*/*.bb \
#    otherlayer1:${LAYERDIR}/dynamic-layers/otherlayer1/recipes-*/*/*.bbappend \
#"
```

## meta-sunplus/recipes-kernel/linux/linux-sp/tppg2/kernel-meta/cfg/rpi-ovls/Kconfig.ovls.patch
```kconfig
--- linux/drivers/of/Kconfig	2018-10-10 21:36:03.983908093 +0300
+++ linux/drivers/of/Kconfig	2018-10-11 11:44:38.505139045 +0300
@@ -112,4 +112,11 @@
 config OF_NUMA
 	bool
 
+config OF_CONFIGFS
+	bool "Device Tree Overlay ConfigFS interface"
+	select CONFIGFS_FS
+	select OF_OVERLAY
+	help
+	  Enable a simple user-space driven DT overlay interface.
+
 endif # OF
```

## meta-tibbo/conf/distro/tps.conf
```bitbake
DISTRO = "tps"
DISTRO_NAME = "TPS (Tibbo Project System)"
DISTRO_VERSION = "3.1.19"
#DISTRO_VERSION:append = "-${DATE}"
DISTRO_CODENAME = "dunfell"
#SDK_VENDOR = "-${DISTRO}sdk"
SDK_VERSION = "${@d.getVar('DISTRO_VERSION').replace('snapshot-${DATE}', 'snapshot')}"
#SDK_VERSION = "${@d.getVar('DISTRO_VERSION')}"

MAINTAINER = "Dvorkin Dmitry <dvorkin@tibbo.com>"

TARGET_VENDOR = "-tps"

# for dunfell
#LOCALCONF_VERSION = "1"
# for honister
LOCALCONF_VERSION = "2"

DISTRO_VERSION[vardepsexclude] = "DATE"
SDK_VERSION[vardepsexclude] = "DATE"

# uncomment for minimal
#DISTRO_FEATURES_DEFAULT = "ext2 ipv4 ipv6 usbgadget usbhost vfat ldconfig"

# Override these in poky based distros
#TIBBO_DEFAULT_DISTRO_FEATURES = "largefile opengl ptest multiarch wayland vulkan"
TIBBO_DEFAULT_DISTRO_FEATURES = "largefile opengl ptest multiarch x11 wayland"
TIBBO_DEFAULT_EXTRA_RDEPENDS = "packagegroup-core-boot"
TIBBO_DEFAULT_EXTRA_RRECOMMENDS = "kernel-module-af-packet"

DISTRO_FEATURES ?= "${DISTRO_FEATURES_DEFAULT} ${TIBBO_DEFAULT_DISTRO_FEATURES}"

SDK_NAME = "${DISTRO}-${TCLIBC}-${SDKMACHINE}-${IMAGE_BASENAME}-${TUNE_PKGARCH}-${MACHINE}"
SDKPATH = "/opt/${DISTRO}/${SDK_VERSION}"

DISTRO_EXTRA_RDEPENDS += " ${TIBBO_DEFAULT_EXTRA_RDEPENDS}"
DISTRO_EXTRA_RRECOMMENDS += " ${TIBBO_DEFAULT_EXTRA_RRECOMMENDS}"

POKYQEMUDEPS = "${@bb.utils.contains("INCOMPATIBLE_LICENSE", "GPL-3.0", "", "packagegroup-core-device-devel",d)}"
DISTRO_EXTRA_RDEPENDS:append:qemuarm = " ${POKYQEMUDEPS}"
DISTRO_EXTRA_RDEPENDS:append:qemuarm64 = " ${POKYQEMUDEPS}"
DISTRO_EXTRA_RDEPENDS:append:qemumips = " ${POKYQEMUDEPS}"
DISTRO_EXTRA_RDEPENDS:append:qemuppc = " ${POKYQEMUDEPS}"
DISTRO_EXTRA_RDEPENDS:append:qemux86 = " ${POKYQEMUDEPS}"
DISTRO_EXTRA_RDEPENDS:append:qemux86-64 = " ${POKYQEMUDEPS}"

TCLIBCAPPEND = ""

PREMIRRORS ??= "\
bzr://.*/.*   http://downloads.yoctoproject.org/mirror/sources/ \n \
cvs://.*/.*   http://downloads.yoctoproject.org/mirror/sources/ \n \
git://.*/.*   http://downloads.yoctoproject.org/mirror/sources/ \n \
gitsm://.*/.* http://downloads.yoctoproject.org/mirror/sources/ \n \
hg://.*/.*    http://downloads.yoctoproject.org/mirror/sources/ \n \
osc://.*/.*   http://downloads.yoctoproject.org/mirror/sources/ \n \
p4://.*/.*    http://downloads.yoctoproject.org/mirror/sources/ \n \
svn://.*/.*   http://downloads.yoctoproject.org/mirror/sources/ \n"

# add poky sanity bbclass
#INHERIT += "poky-sanity"

# QA check settings - a little stricter than the OE-Core defaults
WARN_TO_ERROR_QA = "already-stripped compile-host-path install-host-path \
                    installed-vs-shipped ldflags pn-overrides rpaths staticdev \
                    unknown-configure-option useless-rpaths"
WARN_QA:remove = "${WARN_TO_ERROR_QA}"
ERROR_QA:append = " ${WARN_TO_ERROR_QA}"

#require conf/distro/include/poky-world-exclude.inc
require conf/distro/include/no-static-libs.inc
require conf/distro/include/yocto-uninative.inc
require conf/distro/include/security_flags.inc
INHERIT += "uninative"

INHERIT += "reproducible_build"

BB_SIGNATURE_HANDLER ?= "OEEquivHash"
BB_HASHSERVE ??= "auto"

# DV: additional options

# generate locales, but do not install (see IMAGE_LINGUAS in img)
GLIBC_GENERATE_LOCALES = "en_US.UTF-8 zh_CN.UTF-8 ru_RU.UTF-8 zh_TW.UTF-8 es_ES.UTF-8 en_GB.UTF-8"
LOCALE_UTF8_IS_DEFAULT_class-nativesdk = "1"

# needed for systemd
require conf/distro/include/init-manager-systemd.inc
VIRTUAL-RUNTIME_init_manager = "systemd"
######

DISTRO_FEATURES:append += "bluetooth wifi 3g"
DISTRO_FEATURES:append += "directfb"
#DISTRO_FEATURES:append += "x11 opengl"
#DISTRO_FEATURES:append += "alsa pulseaudio bluez5"
#DISTRO_FEATURES:append += "cramfs"
# OpenAMP
#DISTRO_FEATURES:append += "openamp"
DISTRO_FEATURES:append += "pam"

#PACKAGE_FEED_URIS += "http://192.168.75.150/"
PACKAGE_FEED_URIS += "http://tibbo.com/downloads/LTPS/repo/tppg2"
#PACKAGE_FEED_ARCHS = "all cortexa8hf_neon tpp"

#INHERIT += "sign_package_feed"
#PACKAGE_FEED_GPG_NAME = "Tibbo GPG name"
#PACKAGE_FEED_GPG_PASSPHRASE_FILE = "file://${COREBASE}/x"

# there may also be PREFFERED_VERSION_xxx = .. placed
```

## meta-tibbo/conf/layer.conf
```bitbake
# We have a conf and classes directory, append to BBPATH
BBPATH .= ":${LAYERDIR}"

# We have recipes-* directories, add to BBFILES
BBFILES += "${LAYERDIR}/recipes-*/*/*.bb \
            ${LAYERDIR}/recipes-*/*/*.bbappend"

BBFILE_COLLECTIONS += "tibbo"
BBFILE_PATTERN_tibbo = "^${LAYERDIR}/"
BBFILE_PRIORITY_tibbo = "7"
LAYERVERSION_tibbo = "1"
LAYERSERIES_COMPAT_tibbo = "dunfell honister"
LAYERDEPENDS_tibbo  = "core"
LAYERDEPENDS_tibbo += "networking-layer"
LAYERDEPENDS_tibbo += "multimedia-layer"
LAYERDEPENDS_tibbo += "perl-layer meta-python"
LAYERDEPENDS_tibbo += "webserver"
LAYERRECOMMENDS_tibbo = "qt5-layer sunplus openamp-layer"

# Additional license directories.
LICENSE_PATH += "${LAYERDIR}/files/custom-licenses"
LICENSE_PATH += "${LAYERDIR}/files/common-licenses"

FILESDIR_tibbo := "${LAYERDIR}/files"

# The dynamic-layers directory hosts the extensions and layer specific
# modifications.
#
# The .bbappend and .bb files are included if the respective layer
# collection is available.
BBFILES += "${@' '.join('${LAYERDIR}/dynamic-layers/%s/recipes*/*/*.bbappend' % layer \
               for layer in BBFILE_COLLECTIONS.split())}"
BBFILES += "${@' '.join('${LAYERDIR}/dynamic-layers/%s/recipes*/*/*.bb' % layer \
               for layer in BBFILE_COLLECTIONS.split())}"
# or use strictly specified layer name:
#BBFILES_DYNAMIC += " \
#    atmel:${LAYERDIR}/dynamic-layers/atmel/recipes-*/*/*.bb \
#    atmel:${LAYERDIR}/dynamic-layers/atmel/recipes-*/*/*.bbappend \
#"
```
