## meta-tibbo/conf/machine/tppg2.conf
```bitbake
#@TYPE: Machine
#@NAME: based on SP7021 CPU - TPPg2 machine
#@DESCRIPTION: Machine configuration for the LTPS http://tibbo.com/store/tps/ltpp3.html

# CPU features and optimizations for Pentagram-based boards

DEFAULTTUNE ?= "cortexa9hf-neon"
require conf/machine/include/tune-cortexa9.inc
#require conf/machine/include/arm/armv7a/tune-cortexa9.inc

require conf/machine/include/tpp-prefs.inc
require conf/machine/include/tppg2-all-prefs.inc
require conf/machine/include/tppg2-prefs.inc
require conf/machine/include/tppg2-base.inc

MACHINE_FEATURES  = "serial rtc"
MACHINE_FEATURES += "usbhost"
MACHINE_FEATURES += "usbgadget"
MACHINE_FEATURES += "ext2 vfat"
MACHINE_FEATURES += "bluetooth wifi 3g ppp"
MACHINE_FEATURES += "alsa"
MACHINE_FEATURES += "media-usb-webcams"
MACHINE_FEATURES += "media"
MACHINE_FEATURES += "tpsleds"
# for usb modems ?
# MACHINE_FEATURES += "serial-all usb-net"
MACHINE_FEATURES += "touchscreen"

MACHINE_EXTRA_RRECOMMENDS += "kernel-module-snd kernel-module-snd-timer kernel-module-snd-hrtimer"
MACHINE_EXTRA_RRECOMMENDS += "kernel-module-snd-pcm kernel-module-snd-compress-offload"
MACHINE_EXTRA_RRECOMMENDS += "kernel-module-snd-hwdep kernel-module-snd-rawmidi"
MACHINE_EXTRA_RRECOMMENDS += "kernel-module-snd-sequencer"
MACHINE_EXTRA_RRECOMMENDS += "kernel-module-snd-seq-midi kernel-module-snd-seq-midi-event"
MACHINE_EXTRA_RRECOMMENDS += "kernel-module-snd-opl3-lib kernel-module-snd-opl3-lib-seq"
MACHINE_EXTRA_RRECOMMENDS += "kernel-module-snd-aloop"
MACHINE_EXTRA_RRECOMMENDS += "kernel-module-snd-simple-card kernel-module-snd-simple-card-utils"
MACHINE_EXTRA_RRECOMMENDS += "kernel-module-snd-usb-audio"

EXTRA_IMAGEDEPENDS += "spmake-native"
```

## meta-tibbo/recipes-kernel/dtc/dtc/upd_KLM601-revB-b.its
```
/*
 * Automatic software update for U-Boot
 * Make sure the flashing addresses ('load' prop) is correct for your board!
 */

/dts-v1/;

/ {
	description = "TPS3 + nodejs";
	#address-cells = <1>;

	images {
		update@1 {
			description = "Kernel DTS";
			data = /incbin/("./uImage-am335x-KLM601.revB.dtb");
			compression = "none";
			arch = "arm";
			os = "linux";
			type = "flat_dt";
			tps-upd-to = "NAND.kernel-dts0";
			hash@1 {
				algo = "sha1";
			};
		};
		update@2 {
			description = "Kernel DTS";
			data = /incbin/("./uImage-am335x-TPPs3.dtb");
			compression = "none";
			arch = "arm";
			os = "linux";
			type = "flat_dt";
			tps-upd-to = "NAND.kernel-dts1";
			hash@1 {
				algo = "sha1";
			};
		};
	};
};
```

## meta-tibbo/recipes-kernel/dtc/dtc/upd_KLM601-revC.its
```
/*
 * Automatic software update for U-Boot
 * Make sure the flashing addresses ('load' prop) is correct for your board!
 */

/dts-v1/;

/ {
	description = "TPS3 + nodejs";
	#address-cells = <1>;

	images {
		update@1 {
			description = "U-Boot SPL0";
			data = /incbin/("./MLO-tpp-klm601");
			compression = "none";
			arch = "arm";
			type = "firmware";
			tps-upd-to = "NAND.SPL0";
			hash@1 {
				algo = "sha1";
			};
		};
		update@2 {
			description = "U-Boot SPL1";
			data = /incbin/("./MLO-tpp-klm601");
			compression = "none";
			arch = "arm";
			type = "firmware";
			tps-upd-to = "NAND.SPL1";
			hash@1 {
				algo = "sha1";
			};
		};
		update@3 {
			description = "U-Boot SPL2";
			data = /incbin/("./MLO-tpp-klm601");
			compression = "none";
			arch = "arm";
			type = "firmware";
			tps-upd-to = "NAND.SPL2";
			hash@1 {
				algo = "sha1";
			};
		};
		update@4 {
			description = "U-Boot SPL3";
			data = /incbin/("./MLO-tpp-klm601");
			compression = "none";
			arch = "arm";
			type = "firmware";
			tps-upd-to = "NAND.SPL3";
			hash@1 {
				algo = "sha1";
			};
		};
		update@5 {
			description = "U-Boot binary";
			data = /incbin/("./u-boot.img-klm601");
			compression = "none";
			arch = "arm";
			type = "firmware";
			tps-upd-to = "NAND.u-boot";
			hash@1 {
				algo = "sha1";
			};
		};
		update@6 {
			description = "Kernel DTS";
			data = /incbin/("./uImage-am335x-KLM601.revC.dtb");
			compression = "none";
			arch = "arm";
			os = "linux";
			type = "flat_dt";
			tps-upd-to = "NAND.kernel-dts0";
			hash@1 {
				algo = "sha1";
			};
		};
		update@7 {
			description = "Kernel DTS";
			data = /incbin/("./uImage-am335x-TPPs3.dtb");
			compression = "none";
			arch = "arm";
			os = "linux";
			type = "flat_dt";
			tps-upd-to = "NAND.kernel-dts1";
			hash@1 {
				algo = "sha1";
			};
		};
		update@8 {
			description = "Kernel";
			data = /incbin/("./uImage");
			compression = "none";
			arch = "arm";
			os = "linux";
			type = "kernel";
			tps-upd-to = "NAND.kernel";
			hash@1 {
				algo = "sha1";
			};
		};
		update@9 {
			description = "RootFS";
			data = /incbin/("./TPS-klm-tpp.ubi");
			compression = "none";
			arch = "arm";
			type = "filesystem";
			tps-upd-to = "NAND.rootfs";
			hash@1 {
				algo = "sha1";
			};
		};
	};
};
```

## meta-tibbo/recipes-kernel/dtc/dtc/upd_b_tpp.its
```
/*
 * Automatic software update for U-Boot
 * Make sure the flashing addresses ('load' prop) is correct for your board!
 */

/dts-v1/;

/ {
	description = "Automatic U-Boot update";
	#address-cells = <1>;

	images {
		update@1 {
			description = "U-Boot SPL0";
			data = /incbin/("./MLO-tpp-tpp");
			compression = "none";
			arch = "arm";
			type = "firmware";
			tps-upd-to = "NAND.SPL0";
			hash@1 {
				algo = "sha1";
			};
		};
		update@2 {
			description = "U-Boot binary";
			data = /incbin/("./u-boot.img-tpp");
			compression = "none";
			arch = "arm";
			type = "firmware";
			tps-upd-to = "NAND.u-boot";
			hash@1 {
				algo = "sha1";
			};
		};
	};
};
```

## meta-tibbo/recipes-kernel/dtc/dtc/upd_bad.its
```
/*
 * Automatic software update for U-Boot
 * Make sure the flashing addresses ('load' prop) is correct for your board!
 */

/dts-v1/;

/ {
	description = "Automatic U-Boot update";
	#address-cells = <1>;

	images {
		update@1 {
			description = "U-Boot SPL0";
			data = /incbin/("./MLO");
			compression = "none";
			arch = "arm";
			type = "firmware";
			tps-upd-to = "xNAND.SPL0";
			hash@1 {
				algo = "sha1";
			};
		};
		update@2 {
			description = "U-Boot SPL1";
			data = /incbin/("./MLO");
			compression = "none";
			arch = "arm";
			type = "firmware";
			tps-upd-to = "xNAND.SPL1";
			hash@1 {
				algo = "sha1";
			};
		};
		update@3 {
			description = "U-Boot SPL2";
			data = /incbin/("./MLO");
			compression = "none";
			arch = "arm";
			type = "firmware";
			tps-upd-to = "xNAND.SPL2";
			hash@1 {
				algo = "sha1";
			};
		};
		update@4 {
			description = "U-Boot SPL3";
			data = /incbin/("./MLO");
			compression = "none";
			arch = "arm";
			type = "firmware";
			tps-upd-to = "xNAND.SPL3";
			hash@1 {
				algo = "sha1";
			};
		};
		update@5 {
			description = "U-Boot binary";
			data = /incbin/("./u-boot.img");
			compression = "none";
			arch = "arm";
			type = "firmware";
			tps-upd-to = "xNAND.u-boot";
			hash@1 {
				algo = "sha1";
			};
		};
		update@6 {
			description = "Kernel DTS";
			data = /incbin/("./uImage-am335x-TPPs3.dtb");
			compression = "none";
			arch = "arm";
			os = "linux";
			type = "flat_dt";
			tps-upd-to = "xNAND.kernel-dts0";
			hash@1 {
				algo = "sha1";
			};
		};
		update@7 {
			description = "Kernel";
			data = /incbin/("./uImage");
			compression = "none";
			arch = "arm";
			os = "linux";
			type = "kernel";
			tps-upd-to = "xNAND.kernel";
			hash@1 {
				algo = "sha1";
			};
		};
		update@8 {
			description = "RootFS";
			data = /incbin/("./TPS-agent-tpp.ubi");
			compression = "none";
			arch = "arm";
			type = "filesystem";
			tps-upd-to = "xNAND.rootfs";
			hash@1 {
				algo = "sha1";
			};
		};
	};
};
```

## meta-tibbo/recipes-kernel/linux/linux-yocto/cfg/ovls/Kconfig.configfs.patch
```kconfig
--- a/drivers/of/Kconfig	2015-04-06 02:35:49.000000000 +0300
+++ b/drivers/of/Kconfig	2015-04-06 17:15:13.329331256 +0300
@@ -81,6 +81,11 @@
 	help
 	  Helpers to allow for reservation of memory regions
 
+config OF_CONFIGFS
+	bool "Device Tree Overlay ConfigFS interface"
+	select CONFIGFS_FS
+	def_bool n
+
 config OF_RESOLVE
 	bool
 
@@ -89,5 +93,6 @@
 	depends on OF
 	select OF_DYNAMIC
 	select OF_RESOLVE
+	select OF_CONFIGFS
 
 endmenu # OF
```

## meta-tibbo/recipes-kernel/linux/linux-yocto/cfg/ovls/Kconfig.patch
```kconfig
--- linux/drivers/of/Kconfig	2015-04-06 02:30:39.000000000 +0300
+++ linux/drivers/of/Kconfig	2015-04-06 02:30:54.797192295 +0300
@@ -85,7 +85,7 @@
 	bool
 
 config OF_OVERLAY
-	bool
+	bool "Dv: Device Tree overlays"
 	depends on OF
 	select OF_DYNAMIC
 	select OF_RESOLVE
```

## meta-tibbo/recipes-kernel/linux/linux-yocto/rtl8821c-bt/Kconfig.rtl8821.bluetooth.patch
```kconfig
--- a/drivers/bluetooth/Kconfig	2017-12-05 19:26:18.263002949 +0300
+++ a/drivers/bluetooth/Kconfig	2017-12-06 13:42:08.125066349 +0300
@@ -2,6 +2,12 @@
 menu "Bluetooth device drivers"
 	depends on BT
 
+config BT_RTKBTUSB
+	tristate "RTK HCI USB driver"
+	depends on USB
+	help
+	   RTK Bluetooth HCI USB driver
+
 config BT_INTEL
 	tristate
 	select REGMAP
```

## meta-tibbo/recipes-kernel/linux/linux-yocto/tppg2/linux/drivers/net/ethernet/sp/Kconfig
```kconfig
#
# L2SW device configuration
#

config L2SW_DRIVER
    tristate "L2SW support"
	depends on ETHERNET
	select PHYLIB
        help
          This driver supports L2SW.
```

## meta-tibbo/recipes-kernel/linux/linux-yocto/tppg2/linux/drivers/usb/bc/Kconfig
```kconfig
config USB_BC
	bool "Support Gemini USB Battery Charge"
	depends on USB
	default n
```

## meta-tibbo/recipes-kernel/mod-sppctl/files/kern-mod-sppctl/Kconfig
```kconfig
config PINCTRL_SPPCTL
	bool "SunPlus additional pinmux driver"
	depends on ARCH_PENTAGRAM
	help
	    Say Y here to support SunPlus additional on-the-fly
	    pinmux controller.
	    GPIO is provided by a separate driver.
```

## meta-tibbo/wic/img-bai.tppg2.wks
```
# long-description: Creates a partitioned legacy BIOS disk image that the user
# can directly dd to boot media. The bootloader configuration source is a user file.

#part /boot --source bootimg-pcbios --ondisk sda --label boot --active --align 1024
part /boot --source bootimg-efi --ondisk sda --label boot --active --align 1024 --sourceparams="loader=grub-efi"
part / --source rootfs --ondisk sda --use-uuid --fstype=ext4 --label platform --align 1024
part swap --ondisk sda --size 44 --label swap1 --fstype=swap

#bootloader --configfile="directdisk-bootloader-config.cfg"
bootloader --ptable gpt --timeout=5 --append="rootwait rootfstype=ext4 console=ttyS0,115200 console=tty0"
```

## meta-tibbo/wic/sdimage.tppg2.wks
```
# short-description: Create SD card image with a boot partition
# long-description: Creates a partitioned SD card image. Boot files
# are located in the first vfat partition.

part /boot --source bootimg-partition --ondisk mmcblk0 --fstype=vfat --mkfs-extraopts="-F 32" --label boot --active --align 4 --size 48
part / --source rootfs --ondisk mmcblk0 --fstype=ext4 --label root --align 4
```

## meta-tibbopriv/conf/layer.conf
```bitbake
# We have a conf and classes directory, append to BBPATH
BBPATH .= ":${LAYERDIR}"

# We have recipes-* directories, add to BBFILES
BBFILES += "${LAYERDIR}/recipes-*/*/*.bb \
            ${LAYERDIR}/recipes-*/*/*.bbappend"

BBFILE_COLLECTIONS += "tibbopriv"
BBFILE_PATTERN_tibbopriv = "^${LAYERDIR}/"
BBFILE_PRIORITY_tibbopriv = "9"
LAYERVERSION_tibbopriv = "1"
LAYERSERIES_COMPAT_tibbopriv = "pyro rocko sumo thud warrior zeus"
LAYERDEPENDS_tibbopriv  = "tibbo"
# all of them are in meta-openembedded
LAYERDEPENDS_tibbopriv += "openembedded-layer multimedia-layer networking-layer perl-layer meta-python webserver"
LAYERRECOMMENDS_tibbopriv = "qt5-layer"

# Additional license directories.
LICENSE_PATH += "${LAYERDIR}/files/custom-licenses"

# The dynamic-layers directory hosts the extensions and layer specific
# modifications.
#
# The .bbappend and .bb files are included if the respective layer
# collection is available.
BBFILES += "${@' '.join('${LAYERDIR}/dynamic-layers/%s/recipes*/*/*.bbappend' % layer \
               for layer in BBFILE_COLLECTIONS.split())}"
BBFILES += "${@' '.join('${LAYERDIR}/dynamic-layers/%s/recipes*/*/*.bb' % layer \
               for layer in BBFILE_COLLECTIONS.split())}"
```
